## config/west.yml
```yaml
manifest:
  remotes:
    - name: zmkfirmware
      url-base: https://github.com/zmkfirmware
    - name: urob
      url-base: https://github.com/urob
    - name: englmaxi
      url-base: https://github.com/englmaxi
    - name: joaomaridalho
      url-base: https://github.com/joaomaridalho
  projects:
    - name: zmk
      remote: zmkfirmware
      revision: main
      import: app/west.yml
    - name: zmk-helpers
      remote: urob
      revision: main
    - name: zmk-auto-layer
      remote: urob
      revision: main
    - name: zmk-dongle-display
      remote: englmaxi
      revision: main
    - name: zmk-behavior-num-session
      remote: joaomaridalho
      revision: main
  self:
    path: config
```
