#include <behaviors.dtsi>
#include <dt-bindings/zmk/keys.h>
#include <dt-bindings/zmk/bt.h>
#include <dt-bindings/zmk/outputs.h>
#include <behaviors/num_word.dtsi>
#include <behaviors/num_session.dtsi>
#ifndef KEYMAP_DRAWER
#include "keys_pt.h"
#endif
#include "zmk-helpers/key-labels/totem.h"
#include "zmk-helpers/helper.h"

#define KEYS_L LT0 LT1 LT2 LT3 LT4 LM0 LM1 LM2 LM3 LM4 LB0 LB1 LB2 LB3 LB4 LB5  // Left-hand keys.
#define KEYS_R RT0 RT1 RT2 RT3 RT4 RM0 RM1 RM2 RM3 RM4 RB0 RB1 RB2 RB3 RB4 RB5  // Right-hand keys.
// THUMBS is defined in zmk-helpers/key-labels/totem.h


#define COMBO_TERM_FAST 30
#define COMBO_IDLE_FAST 150


#define BASE       0
#define COLEMAK    1
#define CAPS       2
#define NUM        3
#define SYM        4
#define GAMING     5
#define GAME_PLUS  6
#define FUN        7

#define QUICK_TAP_MS 175

&mt {
    quick-tap-ms = <100>;
    require-prior-idle-ms = <100>;
    flavor = "tap-preferred";
    tapping-term-ms = <170>;
};

&lt {
    tapping-term-ms = <240>;
    flavor = "balanced";
    quick-tap-ms = <150>;
};

#define MAKE_HRM(NAME, HOLD, TAP, TRIGGER_POS)                                 \
  ZMK_HOLD_TAP(NAME, bindings = <HOLD>, <TAP>; flavor = "balanced";            \
               tapping-term-ms = <240>; quick-tap-ms = <QUICK_TAP_MS>;         \
               require-prior-idle-ms = <150>; hold-trigger-on-release;         \
               hold-trigger-key-positions = <TRIGGER_POS>;)

MAKE_HRM(hml, &kp, &kp, KEYS_R THUMBS) // Left-hand HRMs.
MAKE_HRM(hmr, &kp, &kp, KEYS_L THUMBS) // Right-hand HRMs.

ZMK_STICKY_KEY(qsk,
        bindings = <&kp>;
        release-after-ms = <1000>;
        quick-release;
        ignore-modifiers;
)

ZMK_STICKY_KEY(skm,
        bindings = <&kp>;
        release-after-ms = <2000>;
        ignore-modifiers;
)

&caps_word {
    continue-list = <PT_UNDERSCORE LS(PT_C_CEDILLA) BSPC DEL K_CANCEL>;
};

ZMK_AUTO_LAYER(caps_ext,
    continue-list = <PT_UNDERSCORE LS(PT_C_CEDILLA) BSPC DEL K_CANCEL>;
    ignore-alphas;
    ignore-numbers;
    ignore-modifiers;
)

ZMK_MACRO(grave_spc,
    bindings = <&macro_tap &kp PT_GRAVE &kp PT_SPACE>;
    wait-ms = <0>;
    tap-ms = <5>;
)

ZMK_MOD_MORPH(dqt_grave,
    bindings = <&kp PT_DQT>, <&grave_spc>;
    mods = <(MOD_LSFT|MOD_RSFT)>;
)

ZMK_HOLD_TAP(smart_num,
     bindings = <&mo>, <&num_dance>;
     flavor = "balanced";
     tapping-term-ms = <200>;
     quick-tap-ms = <QUICK_TAP_MS>;
 )
 ZMK_TAP_DANCE(num_dance,
     bindings = <&num_session NUM>, <&num_word NUM>;
     tapping-term-ms = <200>;
 )

&num_session {
    continue-list = <DOT>;
};

ZMK_MACRO(smart_num_clear_shift,
    bindings = <&macro_tap &kp K_CANCEL>,
               <&macro_press &smart_num NUM 0>,
               <&macro_pause_for_release>,
               <&macro_release &smart_num NUM 0>;
    wait-ms = <0>;
    tap-ms = <5>;
)

ZMK_MACRO(sym_clear_shift,
    bindings = <&macro_tap &kp K_CANCEL>,
               <&macro_press &mo SYM>,
               <&macro_pause_for_release>,
               <&macro_release &mo SYM>;
    wait-ms = <0>;
    tap-ms = <5>;
)

#define SMART_NUM &smart_num_clear_shift

// Combos capture position events before tap dances can observe them (ZMK #1701),
// so arm sticky shift eagerly and use a separate tap dance only to count taps.
ZMK_MACRO(magic_caps_word,
    bindings = <&macro_tap &kp K_CANCEL &caps_word &caps_ext CAPS>;
    wait-ms = <0>;
    tap-ms = <5>;
)

ZMK_TAP_DANCE(magic_shift_taps,
    tapping-term-ms = <300>;
    bindings = <&none>, <&magic_caps_word>;
)

ZMK_MACRO(magic_shift,
    bindings = <&macro_press &qsk LSHFT &magic_shift_taps>,
               <&macro_pause_for_release>,
               <&macro_release &magic_shift_taps &qsk LSHFT>;
    wait-ms = <0>;
    tap-ms = <5>;
)

ZMK_HOLD_TAP(game_fn,
    bindings = <&mo>, <&kp>;
    flavor = "hold-preferred";
    tapping-term-ms = <200>;
)

ZMK_TRI_STATE(swapper,
    bindings = <&kt LALT>, <&kp TAB>, <&kt LALT>;
    ignored-key-positions = <RM0 RM1 RM2 RM3 RM4>;
    end-on-layer-deactivation = <NUM>;
)
ZMK_TRI_STATE(swapper_prev,
    bindings = <&kt LSHFT>, <&swapper>, <&kt LSHFT>;
    ignored-key-positions = <RM0 RM1 RM2 RM3>;
    end-on-layer-deactivation = <NUM>;
)

// Macros
// MOD MORPHS
ZMK_MOD_MORPH(bs_del,
    bindings = <&kp BSPC>, <&kp DEL>;
    mods = <(MOD_LSFT|MOD_RSFT)>;
)
// ZMK_MOD_MORPH(slsh_blslsh,
//     bindings = <&kp PT_FSLH>, <&kp PT_BSLH>;
//     mods = <(MOD_LSFT|MOD_RSFT)>;
// )
ZMK_MOD_MORPH(lpar_lt,
    bindings = <&kp PT_LPAR>, <&kp PT_LT>;
    mods = <(MOD_LSFT|MOD_RSFT)>;
)
ZMK_MOD_MORPH(rpar_gt,
    bindings = <&kp PT_RPAR>, <&kp PT_GT>;
    mods = <(MOD_LSFT|MOD_RSFT)>;
)
ZMK_MOD_MORPH(lbkt_lbrc,
    bindings = <&kp PT_LBKT>, <&kp PT_LBRC>;
    mods = <(MOD_LSFT|MOD_RSFT)>;)
ZMK_MOD_MORPH(rbkt_rbrc,
    bindings = <&kp PT_RBKT>, <&kp PT_RBRC>;
    mods = <(MOD_LSFT|MOD_RSFT)>;
)
ZMK_MOD_MORPH(quest_excl,
    bindings = <&kp PT_QUESTION>, <&kp PT_EXCL>;
    mods = <(MOD_LSFT|MOD_RSFT)>;
)
ZMK_MOD_MORPH(pipe_ampersand,
    bindings = <&kp PT_PIPE>, <&kp PT_AMPS>;
    mods = <(MOD_LSFT|MOD_RSFT)>;
)
ZMK_MOD_MORPH(slash_bslash,
    bindings = <&kp PT_SLASH>, <&kp PT_BSLH>;
    mods = <(MOD_LSFT|MOD_RSFT)>;
)
ZMK_MOD_MORPH(at_hash,
    bindings = <&kp PT_AT>, <&kp PT_HASH>;
    mods = <(MOD_LSFT|MOD_RSFT)>;
)
ZMK_MOD_MORPH(dqt_sqt,
    bindings = <&kp PT_DQT>, <&kp PT_SQT>;
    mods = <(MOD_LSFT|MOD_RSFT)>;
)
ZMK_MOD_MORPH(equal_percent,
    bindings= <&kp PT_EQUAL>, <&kp PT_PRCNT>;
    mods = <(MOD_LSFT|MOD_RSFT)>;
)
ZMK_MOD_MORPH(dollar_euro,
    bindings= <&kp PT_DOLLAR>, <&kp RA(PT_E)>;
    mods = <(MOD_LSFT|MOD_RSFT)>;
)

// Combos are also active on the CAPS companion layer.
ZMK_COMBO(qrest_excl, &quest_excl, LM2 LM3, BASE COLEMAK CAPS, COMBO_TERM_FAST, COMBO_IDLE_FAST)
ZMK_COMBO(slash_bslash, &slash_bslash, LM1 LM2, BASE COLEMAK CAPS, COMBO_TERM_FAST, COMBO_IDLE_FAST)
ZMK_COMBO(copy, &kp LC(PT_C), LB2 LB3, BASE COLEMAK CAPS)
ZMK_COMBO(paste, &kp LC(PT_V), LB1 LB2, BASE COLEMAK CAPS)
ZMK_COMBO(lpar_lt, &lpar_lt, RM1 RM2, BASE COLEMAK CAPS, COMBO_TERM_FAST, COMBO_IDLE_FAST)
ZMK_COMBO(rpar_gt, &rpar_gt, RM2 RM3, BASE COLEMAK CAPS, COMBO_TERM_FAST, COMBO_IDLE_FAST)
ZMK_COMBO(lbkt_lbrc, &lbkt_lbrc, RB1 RB2, BASE COLEMAK CAPS, COMBO_TERM_FAST, COMBO_IDLE_FAST)
ZMK_COMBO(rbkt_rbrc, &rbkt_rbrc, RB2 RB3, BASE COLEMAK CAPS, COMBO_TERM_FAST, COMBO_IDLE_FAST)
ZMK_COMBO(prcnt, &kp PT_PRCNT, LT1 LT2, BASE COLEMAK CAPS)
ZMK_COMBO(plus, &kp PT_PLUS, LT1 LM1, BASE COLEMAK CAPS)
ZMK_COMBO(sqt, &kp PT_SQT, LT2 LM2, BASE COLEMAK CAPS)
ZMK_COMBO(dqt, &dqt_grave, RT2 RM2, BASE COLEMAK CAPS)
ZMK_COMBO(pipe_ampersand, &pipe_ampersand, LT2 LT3, BASE COLEMAK CAPS)
ZMK_COMBO(dollar_euro, &dollar_euro, LM0 LM1, BASE COLEMAK CAPS)
ZMK_COMBO(at_hash, &at_hash, RM0 RM1, BASE COLEMAK CAPS)
ZMK_COMBO(ordm, &kp PT_ORDM, RT0 RT1, BASE COLEMAK CAPS)
ZMK_COMBO(tilde, &kp PT_TILDE, RT1 RT2, BASE COLEMAK CAPS)
ZMK_COMBO(lt, &kp PT_LT, RT1 RM1, BASE COLEMAK CAPS)
ZMK_COMBO(gt, &kp PT_GT, RT3 RM3, BASE COLEMAK CAPS)
ZMK_COMBO(lbrc, &kp PT_LBRC, RM1 RB1, BASE COLEMAK CAPS)
ZMK_COMBO(rbrc, &kp PT_RBRC, RM3 RB3, BASE COLEMAK CAPS)
ZMK_COMBO(acute, &kp PT_ACUTE, RT2 RT3, BASE COLEMAK CAPS)

#ifndef ZMK_BASE_LAYER
  #define ZMK_BASE_LAYER(name, LT, RT, LM, RM, LB, RB, LH, RH)                 \
      ZMK_LAYER(name, LT RT LM RM LB RB LH RH)
#endif

ZMK_BASE_LAYER(Base,
                     &kp PT_Q         &kp PT_W         &kp PT_E         &kp PT_R         &kp PT_T         , &kp PT_Y         &kp PT_U         &kp PT_I         &kp PT_O        &kp PT_P ,
                     &kp PT_A         &kp PT_S         &kp PT_D         &kp PT_F         &kp PT_G         , &kp PT_H         &kp PT_J         &kp PT_K         &kp PT_L        &kp PT_C_CEDILLA ,
    &kp ESCAPE       &hml LALT PT_Z   &hml LCTRL PT_X  &hml LGUI PT_C   &hml LSHIFT PT_V &kp PT_B         , &kp PT_N         &hmr RSHFT PT_M  &hmr RGUI PT_COMMA &hmr RCTRL PT_DOT &hmr LALT PT_MINUS &bs_del ,
                                                       &lt FUN TAB      &kp RET          &magic_shift     , SMART_NUM        &kp SPACE        &sym_clear_shift
)
ZMK_BASE_LAYER(Colemak,
                     &kp PT_Q         &kp PT_W         &kp PT_F         &kp PT_P         &kp PT_B         , &kp PT_J         &kp PT_L         &kp PT_U         &kp PT_Y        &kp PT_C_CEDILLA,
                     &kp PT_A         &kp PT_R         &kp PT_S         &kp PT_T         &kp PT_G         , &kp PT_M         &kp PT_N         &kp PT_E         &kp PT_I        &kp PT_O,
    &kp ESCAPE       &hml LALT PT_Z   &hml LCTRL PT_X  &hml LGUI PT_C   &hml LSHIFT PT_D &kp PT_V         , &kp PT_K         &hmr RSHFT PT_H  &hmr RGUI PT_COMMA &hmr RCTRL PT_DOT &hmr LALT PT_MINUS &trans,
                                                       &lt FUN TAB      &trans           &trans           , &trans           &trans           &trans
)
ZMK_BASE_LAYER(Caps,
                     &trans           &trans           &trans           &trans           &trans           , &trans           &trans           &trans           &trans          &trans,
                     &trans           &trans           &trans           &trans           &trans           , &trans           &trans           &trans           &trans          &kp LS(PT_C_CEDILLA),
    &trans            &trans           &trans           &trans           &trans           &trans           , &trans           &trans           &trans           &trans          &hmr LALT PT_UNDERSCORE &trans,
                                                       &trans           &trans           &trans           , &trans           &trans           &trans
)
ZMK_BASE_LAYER(Num,
                     &kp PT_SLASH     &kp PT_N7        &kp PT_N8        &kp PT_N9        &kp PT_MINUS     , &none            &kp LC(SPACE)    &kp LG(LC(LEFT)) &kp LG(LC(RIGHT)) &swapper,
                     &kp PT_ASTERISK  &kp PT_N4        &kp PT_N5        &kp PT_N6        &kp PT_PLUS      , &kp LEFT         &kp DOWN         &kp UP           &kp RIGHT       &swapper_prev,
    &kp K_CANCEL     &kp PT_COMMA     &kp PT_N1        &kp PT_N2        &kp PT_N3        &kp PT_EQUAL     , &kp LA(SPACE)    &skm RSHFT       &skm RGUI        &skm RCTRL      &skm LALT    &trans ,
                                                       &kp PT_DOT       &kp RET          &kp PT_N0        , &kp K_CANCEL     &trans           &trans
)
ZMK_BASE_LAYER(Sym,
                     &kp PT_EXCL      &kp PT_LT        &kp PT_GT        &kp PT_EQUAL     &kp PT_PLUS      , &kp PT_PIPE      &kp PT_AMPS      &kp PT_AT        &kp PT_HASH     &kp PT_DOLLAR,
                     &kp PT_QUESTION  &kp PT_LPAR      &kp PT_RPAR      &kp PT_LBKT      &kp PT_RBKT      , &kp PT_SLASH     &kp PT_LBRC      &kp PT_RBRC      &kp PT_DQT      &kp PT_BSLH,
    &kp K_CANCEL     &kp PT_SQT       &kp PT_GRAVE     &kp PT_TILDE     &kp PT_CARET     &kp PT_PRCNT     , &none            &none            &kp PT_SEMI      &kp PT_COLON    &none           &trans,
                                                       &trans           &trans           &trans           , &trans           &trans           &trans
)
ZMK_BASE_LAYER(Gaming,
                     &sl GAME_PLUS    &kp PT_Q         &kp PT_R         &kp PT_E         &kp PT_T         , &kp PT_Y         &kp PT_U         &kp PT_I         &kp PT_O        &kp PT_P ,
                     &kp LSHIFT       &kp PT_A         &kp PT_W         &kp PT_D         &kp PT_F         , &kp PT_H         &kp PT_J         &kp PT_K         &kp PT_L        &kp PT_C_CEDILLA ,
    &kp ESCAPE       &kp TAB          &kp PT_C         &kp PT_S         &kp PT_X         &kp PT_Z         , &kp PT_N         &kp PT_M         &kp PT_COMMA     &kp PT_DOT      &kp PT_MINUS    &bs_del ,
                                                 &game_fn GAME_PLUS RET &kp LCTRL        &kp SPACE        , &mo FUN          &kp RET         &key_repeat

)
ZMK_BASE_LAYER(GamePlus,
                     &kp PT_N1        &kp PT_N2        &kp PT_N3        &kp PT_N4        &kp PT_N5        , &trans           &trans           &trans           &trans          &trans ,
                     &kp PT_M         &kp PT_I         &kp PT_G         &kp PT_B         &kp PT_V         , &trans           &trans           &trans           &trans          &trans ,
    &trans           &kp PT_Z         &trans           &trans           &trans           &trans           , &trans           &trans           &trans           &trans          &trans          &trans ,
                                                       &trans           &trans           &trans           , &trans           &trans           &trans
)
ZMK_BASE_LAYER(Fun,
                     &kp F10          &kp F7           &kp F8           &kp F9           &kp F11          , &tog GAMING      &bt BT_SEL 0     &bt BT_SEL 1     &bt BT_SEL 2    &tog COLEMAK ,
                     &kp F12          &kp F4           &kp F5           &kp F6           &none            , &out OUT_TOG     &bt BT_CLR       &none            &none           &none ,
    &kp K_CANCEL     &none            &kp F1           &kp F2           &kp F3           &none            , &none            &skm RSHFT       &skm RGUI        &skm RCTRL      &skm LALT       &none ,
                                                       &kp F10          &kp RET          &kp F12          , &kp K_CANCEL     &trans           &trans
)
